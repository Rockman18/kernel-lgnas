## drivers/lgnas/Kconfig
```kconfig
menuconfig LGNAS_DEV
	tristate "LGNAS device support"
	default y
	---help---
		This option allows you to select drivers that support
		LG Network Attached Storage.

if LGNAS_DEV

config LGNAS_DEV_HAL
	tristate "HAL DRIVER for LGNAS"
	default m
	---help---
	This HAL Driver Module to control LGNAS Hardwares
	which is button, led, fan, lcd, micom, sensor, and so on.

endif
```

## drivers/pci/pcie/Kconfig
```kconfig
#
# PCI Express Port Bus Configuration
#
config PCIEPORTBUS
	bool "PCI Express support"
	depends on PCI
	help
	  This automatically enables PCI Express Port Bus support. Users can
	  choose Native Hot-Plug support, Advanced Error Reporting support,
	  Power Management Event support and Virtual Channel support to run
	  on PCI Express Ports (Root or Switch).

config ATHEROS_3X3_SUPPORT
	bool "PCI Express support Atheros 3x3 PCIe card"
	depends on PCIEPORTBUS && APM82181
	help
		This automatically enables PCI Express Port Bus supports Atheros
		3x3 PCIe card. With this option, some PCIe cards will cannot run 
		correctly as PCIE NIC IntelPro/1000 PT quad port, SAS LSI 1064E.
choice
        prompt "PCIE Max Payload Size"
        depends on PCIEPORTBUS && APM82181
        default PCIE_MAX_PAYLOAD_SIZE_256

config PCIE_MAX_PAYLOAD_SIZE_128
        bool "128 Bytes"

config PCIE_MAX_PAYLOAD_SIZE_256
        bool "256 Bytes"
endchoice

#
# Include service Kconfig here
#
config HOTPLUG_PCI_PCIE
	tristate "PCI Express Hotplug driver"
	depends on HOTPLUG_PCI && PCIEPORTBUS
	help
	  Say Y here if you have a motherboard that supports PCI Express Native
	  Hotplug

	  To compile this driver as a module, choose M here: the
	  module will be called pciehp.

	  When in doubt, say N.

source "drivers/pci/pcie/aer/Kconfig"

#
# PCI Express ASPM
#
config PCIEASPM
	bool "PCI Express ASPM control" if EMBEDDED
	depends on PCI && PCIEPORTBUS
	default y
	help
	  This enables OS control over PCI Express ASPM (Active State
	  Power Management) and Clock Power Management. ASPM supports
	  state L0/L0s/L1.

	  ASPM is initially set up the the firmware. With this option enabled,
	  Linux can modify this state in order to disable ASPM on known-bad
	  hardware or configurations and enable it when known-safe.

	  ASPM can be disabled or enabled at runtime via
	  /sys/module/pcie_aspm/parameters/policy

	  When in doubt, say Y.
config PCIEASPM_DEBUG
	bool "Debug PCI Express ASPM"
	depends on PCIEASPM
	default n
	help
	  This enables PCI Express ASPM debug support. It will add per-device
	  interface to control ASPM.

config PCIE_PME
	def_bool y
	depends on PCIEPORTBUS && PM_RUNTIME && EXPERIMENTAL && ACPI
```
